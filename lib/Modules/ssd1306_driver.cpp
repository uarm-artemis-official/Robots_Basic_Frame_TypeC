#include "ssd1306_driver.hpp"

// TODO: Test

namespace ssd1306_driver {
    namespace {
        const uint8_t font5x7[][5] = {
            // ASCII 0x20 (space) to 0x7E (~)
            {0x00, 0x00, 0x00, 0x00, 0x00},  // 0x20 ' '
            {0x00, 0x00, 0x5F, 0x00, 0x00},  // 0x21 '!'
            {0x00, 0x07, 0x00, 0x07, 0x00},  // 0x22 '"'
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            {0x08, 0x08, 0x2A, 0x1C, 0x08}   // 0x7E '~'
        };
    }

    void SSD1306Driver::send_command(uint8_t command) {
        uint8_t buf[2] = {0x00, command};
        i2c.master_transmit(MW_I2C::Periperhal::I2C_2, OLED_ADDRESS, buf,
                            sizeof(buf) / sizeof(uint8_t), 0);
    }

    void SSD1306Driver::send_data(uint8_t* data, const size_t size) {
        uint8_t buf[size + 1];
        buf[0] = 0x40;
        memcpy(&buf[1], data, size);
        i2c.master_transmit(MW_I2C::Periperhal::I2C_2, OLED_ADDRESS, buf,
                            size + 1, 0);
    }

    void SSD1306Driver::init() {
        send_command(0xAE);  // Display OFF

        send_command(0xD5);  // Set display clock divide ratio/oscillator freq
        send_command(0x80);  // Default setting

        send_command(0xA8);  // Set multiplex ratio
        send_command(0x3F);  // 1/64 duty

        send_command(0xD3);  // Set display offset
        send_command(0x00);  // No offset

        send_command(0x40);  // Set start line to 0

        send_command(0x8D);  // Enable charge pump
        send_command(0x14);  // Enable

        send_command(0x20);  // Set Memory Addressing Mode
        send_command(0x00);  // Horizontal addressing mode

        send_command(0xA1);  // Segment re-map
        send_command(0xC8);  // COM Output Scan Direction

        send_command(0xDA);  // COM pins hardware config
        send_command(0x12);

        send_command(0x81);  // Set contrast control
        send_command(0xCF);

        send_command(0xD9);  // Set pre-charge period
        send_command(0xF1);

        send_command(0xDB);  // Set VCOMH deselect level
        send_command(0x40);

        send_command(0xA4);  // Resume to RAM content display
        send_command(0xA6);  // Normal display

        send_command(0xAF);  // Display ON
    }

    void SSD1306Driver::clear() {
        Display_t display;
        memset(display.buffer, 0, sizeof(display.buffer));
        write_buffer_to_gddram(&display);
    }

    void SSD1306Driver::write_char_to_buffer(Display_t* display, char c,
                                             uint8_t cursor_row,
                                             uint8_t cursor_col) {
        // TODO: Add checks to make sure cursor_row and cursor_col are non-negative and
        // less than the maximum respective value.
        if (c < 0x20 || c > 0x7E)
            c = '?';
        const uint8_t* glyph = font5x7[c - 0x20];

        // Write glyph to displayBuffer
        for (int i = 0; i < 5; i++) {
            display->buffer[cursor_row][cursor_col++] = glyph[i];
        }
        display->buffer[cursor_row][cursor_col++] = 0x00;  // spacing
    }

    void SSD1306Driver::write_title(Display_t* display,
                                    const Message_t& message, uint8_t offset) {
        memset(display->buffer[0], 0, OLED_WIDTH);
        uint8_t title_length = strlen(message.title);
        uint8_t cursor_col = 0;
        for (int i = offset; i < title_length && i < offset + MAX_COLS; i++) {
            char c = message.title[i] == '\n' ? ' ' : message.title[i];
            write_char_to_buffer(display, c, 0, cursor_col);
            cursor_col += CHAR_WIDTH;
        }
    }

    void SSD1306Driver::write_body(Display_t* display, const Message_t& message,
                                   uint8_t line_start) {
        // Zero body rows.
        for (int i = 1; i < MAX_ROWS; i++) {
            memset(display->buffer[i], 0, OLED_WIDTH);
        }

        uint8_t cursor_row = 1;
        uint8_t cursor_col = 0;
        int body_length = strlen(message.body);
        int i = get_line_start_index(message.body, line_start);
        while (cursor_row < MAX_ROWS && i < body_length && i >= 0) {
            if (message.body[i] == '\n') {
                cursor_row++;
                cursor_col = 0;
            } else {
                write_char_to_buffer(display, message.body[i], cursor_row,
                                     cursor_col);
                cursor_col += CHAR_WIDTH;
                if (cursor_col >= OLED_WIDTH - CHAR_WIDTH) {
                    cursor_row++;
                    cursor_col = 0;
                }
            }
            i++;
        }
    }

    void SSD1306Driver::write_buffer_to_gddram(Display_t* display) {
        for (uint8_t page = 0; page < MAX_ROWS; ++page) {
            send_command(0xB0 + page);
            send_command(0x00);
            send_command(0x10);
            send_data(display->buffer[page], OLED_WIDTH);
        }
    }

    int SSD1306Driver::get_line_start_index(const char* msg, uint8_t line) {
        uint8_t cursor_row = 0;
        uint8_t cursor_col = 0;
        uint8_t good = 0;
        size_t i;
        for (i = 0; i < strlen(msg); i++) {
            if (cursor_row == line) {
                good = 1;
                break;
            }

            if (msg[i] == '\n') {
                cursor_row++;
                cursor_col = 0;
            } else {
                cursor_col += CHAR_WIDTH;
                if (cursor_col >= OLED_WIDTH - CHAR_WIDTH) {
                    cursor_row++;
                    cursor_col = 0;
                }
            }
        }

        if (good == 1) {
            return i;
        } else {
            return -1;
        }
    }

    uint8_t SSD1306Driver::get_line_count(const char* msg) {
        uint8_t cursor_row = 0;
        uint8_t cursor_col = 0;
        uint8_t count = 0;
        int msg_length = strlen(msg);
        for (int i = 0; i < msg_length; i++) {
            if (msg[i] == '\n') {
                cursor_row++;
                cursor_col = 0;
                count++;
            } else {
                cursor_col += CHAR_WIDTH;
                if (cursor_col >= OLED_WIDTH - CHAR_WIDTH) {
                    cursor_row++;
                    cursor_col = 0;
                    count++;
                }
            }
        }

        if (msg[msg_length - 1] != '\n')
            count++;
        return count;
    }
}  // namespace ssd1306_driver